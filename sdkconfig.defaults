## sdkconfig.defaults
```kconfig
# Rust often needs a bit of an extra main task stack size compared to C (the default is 3K)
CONFIG_ESP_MAIN_TASK_STACK_SIZE=50000

# Use this to set FreeRTOS kernel tick frequency to 1000 Hz (100 Hz by default).
# This allows to use 1 ms granuality for thread sleeps (10 ms by default).
#CONFIG_FREERTOS_HZ=1000

# Relates to custom partitions (https://github.com/ollpu/paperslave/commit/62a6cd26985e909e76227e17130f3d74ef2b529b)
# CONFIG_ESPTOOLPY_FLASHSIZE_16MB=y

# Logging
CONFIG_LOG_DEFAULT_LEVEL=5
CONFIG_LOG_DEFAULT_LEVEL_VERBOSE=y
CONFIG_LOG_MAXIMUM_EQUALS_DEFAULT=y
CONFIG_LOG_MAXIMUM_LEVEL=5

CONFIG_LWIP_DEBUG=n
CONFIG_LWIP_DNS_DEBUG=n
CONFIG_LWIP_UDP_DEBUG=n
CONFIG_LWIP_TCP_DEBUG=n
CONFIG_LWIP_IP6_DEBUG=n

# Disable watchdog timers
# CONFIG_ESP_TASK_WDT=n
# CONFIG_INT_WDT=n
CONFIG_ESP_TASK_WDT_TIMEOUT_S=60
```
